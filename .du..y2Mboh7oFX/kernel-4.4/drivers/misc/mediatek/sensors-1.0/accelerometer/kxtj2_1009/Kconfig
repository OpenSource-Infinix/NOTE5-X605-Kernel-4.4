## .du..y2Mboh7oFX/kernel-4.4/drivers/misc/mediatek/sensors-1.0/accelerometer/kxtj2_1009/Kconfig
```kconfig
config MTK_KXTJ2_1009_NEW
	bool "KXTJ for MediaTek package"
	default n
	help
	  It support different accelerometer sensor.
          If this option is set,
	  it will support
          KXTJ Accelerometer.
```
